## conf/layer.conf
```bitbake
# We have a conf and classes directory, add to BBPATH
BBPATH .= ":${LAYERDIR}"

# We have recipes-* directories, add to BBFILES
BBFILES += "${LAYERDIR}/recipes-*/*/*.bb \
	${LAYERDIR}/recipes-*/*/*.bbappend"

BBFILE_COLLECTIONS += "meta-rcar-adas"
BBFILE_PATTERN_meta-rcar-adas = "^${LAYERDIR}/"
BBFILE_PRIORITY_meta-rcar-adas = "6"
LAYERSERIES_COMPAT_meta-rcar-adas = "dunfell kirkstone"

LAYERDEPENDS_meta-rcar-adas = "core yocto openembedded-layer meta-python"

BBFILES_DYNAMIC += " \
    virtualization-layer:${LAYERDIR}/dynamic-layers/meta-virtualization/*/*/*.bb \
    virtualization-layer:${LAYERDIR}/dynamic-layers/meta-virtualization/*/*/*.bbappend \
"

# Root directory for the meta-renesas/dynamic-layers/meta-virtualization
RCAR_ADAS_VIRTUALIZATION_DYNAMIC_DIR := "${LAYERDIR}/dynamic-layers/meta-virtualization"
```

## dynamic-layers/meta-virtualization/conf/machine/include/image-tweaks-spider-machine-xen.inc
```bitbake
# SPDX-License-Identifier: MIT

GRUB_CFG_FILE ?= "${RCAR_GATEWAY_VIRTUALIZATION_DYNAMIC_DIR}/wic/gateway-xen-grub.cfg"

WKS_SEARCH_PATH:prepend = "${RCAR_GATEWAY_VIRTUALIZATION_DYNAMIC_DIR}/wic:"

IMAGE_EFI_BOOT_FILES += "xen-spider.efi;xen.efi xen.cfg \
                     ${RCAR_GATEWAY_LAYERDIR}/wic/gateway-grub.cfg;./EFI/BOOT"

do_image_wic[depends] += "xen:do_deploy"
```

## dynamic-layers/meta-virtualization/conf/machine/include/image-tweaks-whitehawk-machine-xen.inc
```bitbake
# SPDX-License-Identifier: MIT

GRUB_CFG_FILE ?= "${RCAR_ADAS_VIRTUALIZATION_DYNAMIC_DIR}/wic/adas-xen-grub.cfg"

WKS_SEARCH_PATH:prepend = "${RCAR_ADAS_VIRTUALIZATION_DYNAMIC_DIR}/wic:"

IMAGE_EFI_BOOT_FILES += "xen-whitehawk.efi;xen.efi xen.cfg \
                     ${RCAR_ADAS_LAYERDIR}/wic/adas-grub.cfg;./EFI/BOOT"

do_image_wic[depends] += "xen:do_deploy"
```

## meta-rcar-adas/conf/layer.conf
```bitbake
# We have a conf and classes directory, add to BBPATH
BBPATH .= ":${LAYERDIR}"

# We have recipes-* directories, add to BBFILES
BBFILES += "${LAYERDIR}/recipes-*/*/*.bb \
	${LAYERDIR}/recipes-*/*/*.bbappend"

BBFILE_COLLECTIONS += "rcar-adas"
BBFILE_PATTERN_rcar-adas = "^${LAYERDIR}/"
BBFILE_PRIORITY_rcar-adas = "6"
LAYERSERIES_COMPAT_rcar-adas = "dunfell kirkstone"

LAYERDEPENDS_rcar-adas = "core yocto openembedded-layer meta-python"

# BBFILES_DYNAMIC += " \
#     virtualization-layer:${LAYERDIR}/dynamic-layers/meta-virtualization/*/*/*.bb \
#     virtualization-layer:${LAYERDIR}/dynamic-layers/meta-virtualization/*/*/*.bbappend \
# "

# # Root directory for the meta-adlink-ampere/dynamic-layers/meta-virtualization
# RCAR_ADAS_VIRTUALIZATION_DYNAMIC_DIR := "${LAYERDIR}/dynamic-layers/meta-virtualization"
```
